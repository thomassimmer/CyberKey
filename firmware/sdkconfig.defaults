## firmware/sdkconfig.defaults
```kconfig
# BLE via NimBLE (Classic BT disabled to save RAM)
CONFIG_BT_ENABLED=y
CONFIG_BT_NIMBLE_ENABLED=y
CONFIG_BT_CONTROLLER_ONLY=n
CONFIG_BT_NIMBLE_MAX_CONNECTIONS=3
CONFIG_BTDM_CTRL_BLE_MAX_CONN=3

# Persist bond keys (LTK + IRK) across power cycles.
# Without this, NimBLE uses a RAM-only store: the bond is lost on every reboot,
# which prevents macOS from reconnecting automatically.
CONFIG_BT_NIMBLE_NVS_PERSIST=y

# Stack sizes
CONFIG_BT_NIMBLE_HOST_TASK_STACK_SIZE=16384
CONFIG_FREERTOS_HZ=1000
CONFIG_ESP_MAIN_TASK_STACK_SIZE=16384

CONFIG_PM_ENABLE=y
CONFIG_FREERTOS_USE_TICKLESS_IDLE=y
CONFIG_PM_DFS_INIT_AUTO=y

# RUN_BLE_ON_SUSPEND is required: without it the BT controller holds a
# NO_LIGHT_SLEEP lock permanently, making light sleep impossible regardless of
# unicore mode.
CONFIG_BT_NIMBLE_RUN_BLE_ON_SUSPEND=y

# BT modem sleep reduces BLE radio power between events (~20-25 mA saving).
# ORIG mode (mode 1) is the only mode available on ESP32.
# SLEEP_CLOCK_USE_MAIN_XTAL avoids the 32 kHz crystal requirement: the
# ESP32-PICO on M5StickC Plus 2 has no external 32 kHz XTAL wired to the BT
# controller, so without this flag the BTDM controller cannot find its sleep
# clock and enters a crash/reboot loop.  The main 40 MHz XTAL divided internally
# is slightly less accurate but fully functional.
CONFIG_BT_CTRL_MODEM_SLEEP=y
CONFIG_BT_CTRL_MODEM_SLEEP_MODE_1=y
CONFIG_BT_CTRL_SLEEP_CLOCK_USE_MAIN_XTAL=y

# PM profiling: enables esp_pm_dump_locks() which logs every active PM lock.
CONFIG_PM_PROFILING=y

# Single-core mode: required for automatic light sleep on ESP32.
# ESP-IDF explicitly documents that tickless idle light sleep is only supported
# in single-core mode; in dual-core mode both cores must be simultaneously idle,
# which never happens with BLE and UART driver tasks running.
# Also powers off Core 1 entirely, saving ~10-15 mA.
CONFIG_FREERTOS_UNICORE=y
```
